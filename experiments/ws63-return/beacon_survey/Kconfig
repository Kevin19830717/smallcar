## experiments/ws63-return/beacon_survey/Kconfig
```kconfig
config SAMPLE_SUPPORT_BEACON_SURVEY_TX
    bool "R550 fixed RSSI beacon with SLE return server"

config SAMPLE_SUPPORT_BEACON_SURVEY_RX
    bool "R550 mobile RSSI scanner with SLE return client"
    depends on AT_SUPPORT_PLT
```
